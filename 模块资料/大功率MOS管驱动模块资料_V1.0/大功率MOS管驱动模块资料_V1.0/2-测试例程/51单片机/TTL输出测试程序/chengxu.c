/**********************************************************************************
 * 功能描述：控制IO口P1.0每隔5s循环切换高低电平输出
**********************************************************************************/
#include <reg52.h>  	       //库文件
#define uchar unsigned char//宏定义无符号字符型
#define uint unsigned int  //宏定义无符号整型
#include <intrins.h>

/********************************************************************
                            I/O定义
*********************************************************************/
sbit OUT=P1^0;	 //定义单片机P1口的第1位 （即P1.0）为驱动输出口
/********************************************************************
                            延时函数
*********************************************************************/
void delay()//延时程序
{
uchar m,n,s;
for(m=20;m>0;m--)
for(n=20;n>0;n--)
for(s=248;s>0;s--);
}
void Delay5000ms()		//@11.0592MHz
{
	unsigned char i, j, k;

	_nop_();
	i = 36;
	j = 5;
	k = 211;
	do
	{
		do
		{
			while (--k);
		} while (--j);
	} while (--i);
}
/********************************************************************
                            主函数
*********************************************************************/
void main()
{
	OUT=0;	   //初始关闭
	while(1)   //无限循环
	{
	  OUT=1;	   //闭合
		Delay5000ms();
		OUT=0;	   //关闭
		Delay5000ms();
	}
}	
/********************************************************************
                              结束
*********************************************************************/